## boards/arm/mdbt50q/Kconfig.board
```kconfig
# Raytec MDBT50Q board configuration

# Copyright (c) 2020 The ZMK Contributors
# SPDX-License-Identifier: MIT

config BOARD_MDBT50Q
    bool "mdbt50q"
    depends on SOC_NRF52840_QIAA
```

## boards/arm/mdbt50q/Kconfig.defconfig
```kconfig
# Copyright (c) 2020 The ZMK Contributors
# SPDX-License-Identifier: MIT

if BOARD_MDBT50Q

config BOARD
    default "mdbt50q"

if USB_DEVICE_STACK

config USB_NRFX
    default y

endif # USB_DEVICE_STACK

config BT_CTLR
    default BT

endif # BOARD_MDBT50Q
```

## boards/arm/nrf52840_m3/Kconfig.board
```kconfig
# Maker Diary nrf52840 M.3 board configuration

# Copyright (c) 2020 The ZMK Contributors
# SPDX-License-Identifier: MIT

config BOARD_NRF52840_M3
    bool "nrf52480_m3"
    depends on SOC_NRF52840_QIAA
```

## boards/arm/nrf52840_m3/Kconfig.defconfig
```kconfig
# Copyright (c) 2020 The ZMK Contributors
# SPDX-License-Identifier: MIT

if BOARD_NRF52840_M3

config BOARD
    default "nrf52480_m3"

if USB_DEVICE_STACK

config USB_NRFX
    default y

endif # USB_DEVICE_STACK

config BT_CTLR
    default BT

endif # BOARD_NRF52840_M3
```

## boards/shields/jakcon/Kconfig.defconfig
```kconfig
if JAKCON
config USB_DEVICE_MANUFACTURER
    default "Kivotos"
config ZMK_KEYBOARD_NAME
    default "JAK CON"	
endif
```
